/*
 * Copyright (c) 2026 BP Keyboard
 * SPDX-License-Identifier: MIT
 *
 * BP分体键盘 - 右键盘 (Peripheral角色)
 * 矩阵: 6行 x 9列
 */

#include "bp_keyboard.dtsi"

/ {
    kscan0: kscan_matrix_0 {
        col-gpios
            = <&pro_micro 2 GPIO_ACTIVE_HIGH>
            , <&pro_micro 6 GPIO_ACTIVE_HIGH>
            , <&pro_micro 7 GPIO_ACTIVE_HIGH>
            , <&pro_micro 8 GPIO_ACTIVE_HIGH>
            , <&pro_micro 9 GPIO_ACTIVE_HIGH>
            , <&pro_micro 5 GPIO_ACTIVE_HIGH>
            , <&pro_micro 4 GPIO_ACTIVE_HIGH>
            , <&pro_micro 0 GPIO_ACTIVE_HIGH>
            , <&pro_micro 1 GPIO_ACTIVE_HIGH>
            ;
    };
};

// 关键：右键盘列偏移9，使其映射到统一矩阵的9-17列
&matrix_transform0 {
    col-offset = <9>;
};