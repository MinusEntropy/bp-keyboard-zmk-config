## boards/shields/bp_keyboard/Kconfig.defconfig
```kconfig
# SPDX-License-Identifier: MIT

if SHIELD_BP_KEYBOARD_LEFT

config ZMK_KEYBOARD_NAME
    default "BP Keyboard Left"

config ZMK_SPLIT_ROLE_CENTRAL
    default y

# USB 会自动启用，无需显式配置

endif

if SHIELD_BP_KEYBOARD_RIGHT

config ZMK_KEYBOARD_NAME
    default "BP Keyboard Right"

# 右键盘默认就是 Peripheral 角色，无需设置 ZMK_SPLIT_ROLE_CENTRAL

endif

# 分体键盘功能默认启用
if SHIELD_BP_KEYBOARD_LEFT || SHIELD_BP_KEYBOARD_RIGHT

config ZMK_SPLIT
    default y

# 蓝牙默认启用
config ZMK_BLE
    default y

endif
```

## boards/shields/bp_keyboard/Kconfig.shield
```kconfig
# SPDX-License-Identifier: MIT

config SHIELD_BP_KEYBOARD_LEFT
    def_bool $(shields_list_contains,bp_keyboard_left)

config SHIELD_BP_KEYBOARD_RIGHT
    def_bool $(shields_list_contains,bp_keyboard_right)
```
