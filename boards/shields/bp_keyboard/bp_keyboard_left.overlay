/*
 * Copyright (c) 2026 BP Keyboard
 * SPDX-License-Identifier: MIT
 *
 * BP分体键盘 - 左键盘 (Central角色)
 * 矩阵: 6行 x 9列
 */

#include "bp_keyboard.dtsi"

/ {
    kscan0: kscan_matrix_0 {
        col-gpios
            = <&pro_micro 1 GPIO_ACTIVE_HIGH>
            , <&pro_micro 0 GPIO_ACTIVE_HIGH>
            , <&pro_micro 4 GPIO_ACTIVE_HIGH>
            , <&pro_micro 5 GPIO_ACTIVE_HIGH>
            , <&pro_micro 6 GPIO_ACTIVE_HIGH>
            , <&pro_micro 7 GPIO_ACTIVE_HIGH>
            , <&pro_micro 8 GPIO_ACTIVE_HIGH>
            , <&pro_micro 9 GPIO_ACTIVE_HIGH>
            , <&pro_micro 2 GPIO_ACTIVE_HIGH>
            ;
    };

    // 覆盖EXT_POWER配置，使用GPIO_ACTIVE_LOW
    // 这样驱动初始化后调用enable时，GPIO0.13输出低电平，VCC关闭
    // 电路原理：GPIO低电平 → ME6217 EN低 → VCC关闭
    EXT_POWER {
        compatible = "zmk,ext-power-generic";
        control-gpios = <&gpio0 13 GPIO_ACTIVE_LOW>;
        init-delay-ms = <50>;
    };
};

// 左键盘列偏移为0（可省略）
&matrix_transform0 {
    col-offset = <0>;
};