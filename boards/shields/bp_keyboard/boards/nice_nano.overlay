/*
 * Copyright (c) 2026 BP Keyboard
 * SPDX-License-Identifier: MIT
 *
 * 禁用nice_nano的外部电源控制（PCB未使用VCC输出）
 *
 * nice_nano v1 使用 GPIO0.13 (GPIO_ACTIVE_LOW) 控制 ME6217 LDO
 * 通过 gpio-hog 强制将 GPIO0.13 设为高电平，关闭VCC输出
 * 注意：v1是低电平有效，所以需要output-high来关闭VCC
 */

/ {
    // 禁用外部电源控制节点
    EXT_POWER {
        status = "disabled";
    };
};

/*
 * 使用 gpio-hog 将 GPIO0.13 配置为输出高电平
 * nice_nano v1: GPIO_ACTIVE_LOW，高电平=关闭VCC
 */
&gpio0 {
    ext_power_off: ext_power_off {
        gpio-hog;
        gpios = <13 GPIO_ACTIVE_LOW>;
        output-high;
    };
};