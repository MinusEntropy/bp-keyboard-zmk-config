/*
 * Copyright (c) 2026 BP Keyboard
 * SPDX-License-Identifier: MIT
 *
 * 禁用nice_nano的外部电源控制（PCB未使用VCC输出）
 */

/ {
    // 禁用外部电源控制节点
    EXT_POWER {
        status = "disabled";
    };
};

&gpio0 {
    ext_power_off: ext_power_off {
        gpio-hog;
        gpios = <13 GPIO_ACTIVE_LOW>;
        output-high;
    };
};